## sdkconfig.defaults
```kconfig
# YD-ESP32-23 / ESP32-S3-WROOM-1-N16R8
CONFIG_IDF_TARGET="esp32s3"

# 16 MB quad-SPI flash, using the mode already verified on this board.
CONFIG_ESPTOOLPY_FLASHMODE_DIO=y
CONFIG_ESPTOOLPY_FLASHFREQ_80M=y
CONFIG_ESPTOOLPY_FLASHSIZE_16MB=y

# Keep the upstream 8 MB partition layout for the initial compatibility and
# boot milestone. The upper half of flash is intentionally unused for now.
CONFIG_PARTITION_TABLE_CUSTOM=y
CONFIG_PARTITION_TABLE_CUSTOM_FILENAME="nut_fat_8MB.csv"

# 8 MB octal PSRAM at the module's verified operating speed.
CONFIG_SPIRAM=y
CONFIG_SPIRAM_MODE_OCT=y
CONFIG_SPIRAM_SPEED_80M=y
CONFIG_SPIRAM_BOOT_INIT=y
CONFIG_SPIRAM_MEMTEST=y

# Leave room for complete UPS configuration and string descriptors during
# read-only USB discovery.
CONFIG_USB_HOST_CONTROL_TRANSFER_MAX_SIZE=1024

# Preserve logs on the direct USB Serial/JTAG development connection while
# retaining the upstream UART console.
CONFIG_ESP_CONSOLE_UART_DEFAULT=y
CONFIG_ESP_CONSOLE_SECONDARY_USB_SERIAL_JTAG=y

# This network's DHCP server successfully ACKs the ESP32 lease, but the
# ESP32-side ARP probe falsely rejects the offered address. Rely on the DHCP
# server's address management rather than repeating that client-side probe.
CONFIG_LWIP_DHCP_DOES_NOT_CHECK_OFFERED_IP=y

# The HTTPS server reserves three internal sockets and permits four concurrent
# clients. Leave bounded headroom for the read-only NUT service, DHCP/SNTP, and
# transient browser or Agent connections instead of relying on the ESP-IDF
# default of ten shared LWIP sockets.
CONFIG_LWIP_MAX_SOCKETS=16

# Boot a newly installed OTA application in pending-verification state. The
# application marks itself valid only after core services have started.
CONFIG_BOOTLOADER_APP_ROLLBACK_ENABLE=y

# Operational Management v2.0.0 foundation: the device hosts its administration
# console over HTTPS. The certificate and private key are generated per device
# on first boot and retained in NVS until factory reset.
CONFIG_ESP_HTTPS_SERVER_ENABLE=y
CONFIG_MBEDTLS_X509_CREATE_C=y
```
